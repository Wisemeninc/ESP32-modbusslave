## sdkconfig.defaults
```kconfig
# Modbus Configuration
CONFIG_FMB_COMM_MODE_RTU_EN=y
CONFIG_FMB_COMM_MODE_ASCII_EN=n
CONFIG_FMB_MASTER_TIMEOUT_MS_RESPOND=150
CONFIG_FMB_MASTER_DELAY_MS_CONVERT=200
CONFIG_FMB_QUEUE_LENGTH=20
CONFIG_FMB_SERIAL_TASK_STACK_SIZE=4096
CONFIG_FMB_SERIAL_BUF_SIZE=256
CONFIG_FMB_SERIAL_ASCII_BITS_PER_SYMB=8
CONFIG_FMB_SERIAL_ASCII_TIMEOUT_RESPOND_MS=1000
CONFIG_FMB_PORT_TASK_PRIO=10
CONFIG_FMB_PORT_TASK_AFFINITY_NO_AFFINITY=y
CONFIG_FMB_PORT_TASK_AFFINITY=0x7FFFFFFF
CONFIG_FMB_TIMER_PORT_ENABLED=y
CONFIG_FMB_TIMER_GROUP=0
CONFIG_FMB_TIMER_INDEX=0
CONFIG_FMB_TIMER_ISR_IN_IRAM=n

# UART Configuration
CONFIG_MB_UART_PORT_NUM=1
CONFIG_MB_UART_BAUD_RATE=9600
CONFIG_MB_UART_TXD=17
CONFIG_MB_UART_RXD=16
CONFIG_MB_UART_RTS=18

# Slave Configuration
CONFIG_MB_SLAVE_ADDR=1

# Enable RTU mode
CONFIG_MB_COMM_MODE_RTU=y

# FreeRTOS Configuration
CONFIG_FREERTOS_HZ=1000
CONFIG_FREERTOS_USE_TRACE_FACILITY=y
CONFIG_FREERTOS_GENERATE_RUN_TIME_STATS=n

# ESP System Settings
CONFIG_ESP_TASK_WDT_TIMEOUT_S=10
CONFIG_ESP_TASK_WDT_CHECK_IDLE_TASK_CPU0=y
CONFIG_ESP_TASK_WDT_CHECK_IDLE_TASK_CPU1=y

# UART Driver
CONFIG_UART_ISR_IN_IRAM=y
```
